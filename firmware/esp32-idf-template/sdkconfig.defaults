## firmware/esp32-idf-template/sdkconfig.defaults
```kconfig
CONFIG_ESPTOOLPY_MONITOR_BAUD_115200=y
CONFIG_ESPTOOLPY_MONITOR_BAUD=115200
CONFIG_PARTITION_TABLE_SINGLE_APP=y
CONFIG_PARTITION_TABLE_OFFSET=0x8000
```
